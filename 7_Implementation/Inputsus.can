/*@!Encoding:1252*/
includes
{
  
}


variables
{ msTimer t1;
  int x=0;
  message Input_data_gyromessage gyromsg;

}
 
on sysvar Vehicleattributes::moving
{ if(@Vehicleattributes::moving==0){
  if(@IGNITION::KL15==0){
    write("Ignition is OFF");
    cancelTimer(t1);}
  else{ 
    write("Ignition is ON Vehicle not moving");
  }
}else{
  if(@IGNITION::KL15==0){
    write("Ignition is OFF");
    cancelTimer(t1);   
  }else{
     write("Ignition is ON");
    setTimer(t1,500);
    
  }
  
}
  

 
}
 
on timer t1
{ if(x==0){
  setSignal(gyroscopeX,30);
  setSignal(gyroscopeY,0);
  setSignal(gyroscopeZ,0);
  output(gyromsg);
  x=1;
   }else if(x==1)
  {
  setSignal(gyroscopeX,0);
  setSignal(gyroscopeY,30);
  setSignal(gyroscopeZ,0);
  output(gyromsg);
  x=2;
     
   }else if(x==2){
   setSignal(gyroscopeX,0);
  setSignal(gyroscopeY,0);
  setSignal(gyroscopeZ,30);
  output(gyromsg);
  x=3;
   }else if(x==3){
    setSignal(gyroscopeX,-30);
  setSignal(gyroscopeY,0);
  setSignal(gyroscopeZ,0);
  output(gyromsg);
  x=4;     
   }else if(x==4){
    setSignal(gyroscopeX,0);
  setSignal(gyroscopeY,-30);
  setSignal(gyroscopeZ,0);
  output(gyromsg);
  x=0;}

     
  
  setTimer(t1,5000);
  
  
}

