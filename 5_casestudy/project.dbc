VERSION ""

NS_ :

BS_:

BU_: R3 R2 R1

BO_ 3 New_Message_3: 1 R3
 SG_ New_Signal_3 : 0|8@1- (1,0) [0|0] "" Vector__XXX

BO_ 2 New_Message_2: 1 R2
 SG_ New_Signal_2 : 0|8@1- (1,0) [0|0] "" Vector__XXX

BO_ 1 New_Message_1: 1 R1
 SG_ New_Signal_1 : 0|8@1- (1,0) [0|0] "" Vector__XXX

BA_DEF_  "BusType" STRING ;
BA_DEF_DEF_  "BusType" "CAN";
