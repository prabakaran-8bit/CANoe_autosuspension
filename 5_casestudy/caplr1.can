/*@!Encoding:1252*/
includes
{
  
}

 

variables
{
  timer Timer1,Timer3,Timer4,Timer5;
  msTimer Timer2;
  message New_Message_1 msg1;
}

 

on start
{
  write("Simluation has Started");
}

 

on key 's'
{
  if(@Ignition::KL15==1)
  {
    @Ignition::KL15=0;
  }
  else if(@Ignition::KL15==0)
  { 
    @Ignition::KL15=1;
  }
}

 

on sysvar Ignition::KL15
{
  if(@Ignition::KL15==0)
  {
    write("Ignition is OFF");
  }
  else if(@Ignition::KL15==1)
  {
    write("Ignition is ON ");
    setTimer(Timer1,5);
    output(msg1);
  }
}

 

on timer Timer1
{
  setSignal(New_Signal_1,20);
  
  output(msg1);
  setTimer(Timer2,5000);
}

on timer Timer2
{
  $New_Signal_1=40;
  output(msg1);
  setTimer(Timer3,5);
}
on timer Timer3
{
  $New_Signal_1=35;
  output(msg1);
  setTimer(Timer4,5);
}
on timer Timer4
{
  $New_Signal_1=30;
  output(msg1);
  setTimer(Timer5,5);
}
on timer Timer5
{
  $New_Signal_1=10;
  output(msg1);
  setTimer(Timer1,5);
}
